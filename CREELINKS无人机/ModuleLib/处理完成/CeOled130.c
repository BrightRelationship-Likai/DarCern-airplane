/**
  ******************************************************************************
  * @file    CeOled130.c
  * @author  Creelinks Application Team
  * @version V1.0.0
  * @date    2017-01-06
  * @brief   适用于CeOled130模块的驱动库文件
  ******************************************************************************
  * @attention
  *
  *1)130实际用到的分辨率为128 * 64，但内部的SSH1106为132 * 64
  *
  * <h2><center>&copy; COPYRIGHT 2016 Darcern</center></h2>
  ******************************************************************************
  */
#include "CeOled130.h"
#ifdef __cplusplus
 extern "C" {
#endif //__cplusplus
#define CE_OLED130_ADDRESS        0x78 //通过调整0R电阻,屏可以0x78和0x7A两个地址 -- 默认0x78
/**
  * @brief    CeOled130使用的6*8的点阵
  */
const unsigned char CE_OLED130_F6x8[][6] =
{
    0x00, 0x00, 0x00, 0x00, 0x00, 0x00, // sp
    0x00, 0x00, 0x00, 0x2f, 0x00, 0x00, // !
    0x00, 0x00, 0x07, 0x00, 0x07, 0x00, // "
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    0x14, 0x14, 0x14, 0x14, 0x14, 0x14, // horiz lines
};
/**
  * @brief    CeOled130使用的8*16的点阵
  */
const unsigned char CE_OLED130_F8X16[] =
{
    0x00, 0x00, 0x00, 0x00, 0x00, 0x00, 0x00, 0x00, 0x00, 0x00, 0x00, 0x00, 0x00, 0x00, 0x00, 0x00, // 0
    0x00, 0x00, 0x00, 0xF8, 0x00, 0x00, 0x00, 0x00, 0x00, 0x00, 0x00, 0x33, 0x30, 0x00, 0x00, 0x00, //! 1
    0x00, 0x10, 0x0C, 0x06, 0x10, 0x0C, 0x06, 0x00, 0x00, 0x00, 0x00, 0x00, 0x00, 0x00, 0x00, 0x00, //" 2
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    0x00, 0x06, 0x01, 0x01, 0x02, 0x02, 0x04, 0x04, 0x00, 0x00, 0x00, 0x00, 0x00, 0x00, 0x00, 0x00, //~ 94
};

/**
  * @brief  CeOled130往指定地址写1个字节的数据
  * @param  ceOled130:CeOled130属性对象
  * @param  addr:要写入数据的地址
  * @param  data:要写入的数据
  * @return None
  */
void ceOled130_writeByte(CeOled130* ceOled130, uint8 addr, uint8 dataVal)
{
    ceI2cMasterOp.start(&ceOled130->ceI2cMaster);
    ceI2cMasterOp.writeByte(&ceOled130->ceI2cMaster, CE_OLED130_ADDRESS);
    ceI2cMasterOp.waitAck(&ceOled130->ceI2cMaster);
    ceI2cMasterOp.writeByte(&ceOled130->ceI2cMaster, addr);
    ceI2cMasterOp.waitAck(&ceOled130->ceI2cMaster);
    ceI2cMasterOp.writeByte(&ceOled130->ceI2cMaster, dataVal);
    ceI2cMasterOp.waitAck(&ceOled130->ceI2cMaster);
    ceI2cMasterOp.stop(&ceOled130->ceI2cMaster);
}

/**
  * @brief  CeOled130写命令
  * @param  ceOled130:CeOled130属性对象
  * @param  I2C_Command:要写入的命令
  * @return None
  */
void ceOled130_writeCmd(CeOled130* ceOled130, uint8 I2C_Command)
{
    ceOled130_writeByte(ceOled130, 0x00, I2C_Command);
}

/**
  * @brief  CeOled130写数据
  * @param  ceOled130:CeOled130属性对象
  * @param  I2C_Data:要写入的数据
  * @return None
  */
void ceOled130_writeDat(CeOled130* ceOled130, uint8 I2C_Data)
{
    ceOled130_writeByte(ceOled130, 0x40, I2C_Data);
}

/**
  * @brief  CeOled130模块初始化
  * @param  ceOled130:CeOled130属性对象
  * @param  ceXX:CeOled130模块使用的资源号
  * @return 系统状态码
  */
CE_STATUS ceOled130_initial(CeOled130* ceOled130, CE_RESOURCE ceI2c)
{
    uint8 i, j;
    for (j = 0; j < CE_OLED130_WIDTH / 6; j++)
    {
        for (i = 0; i < CE_OLED130_HIGHT / 8; i++)
        {
            ceOled130->asBuf[j][i] = ' ';
        }
    }
    ceOled130->asXIndex = 0;
    ceOled130->asYIndex = 0;

    ceOled130->ceI2cMaster.ceResource = ceI2c;
    ceOled130->ceI2cMaster.ceI2cMasterSpeed = CE_I2C_SPEED_3_4MBPS;
    ceI2cMasterOp.initial(&ceOled130->ceI2cMaster);
    ceSystemOp.delayMs(100); //这里的延时很重要
    ceOled130_writeCmd(ceOled130, 0xAE); //--display off
    ceOled130_writeCmd(ceOled130, 0x02); //---set low column address
    ceOled130_writeCmd(ceOled130, 0x10); //---set high column address
    ceOled130_writeCmd(ceOled130, 0x40); //--set start line address
    ceOled130_writeCmd(ceOled130, 0xB0); //--set page address
    ceOled130_writeCmd(ceOled130, 0x81); // contract control
    ceOled130_writeCmd(ceOled130, 0xFF); //--128
    ceOled130_writeCmd(ceOled130, 0xA1); //set segment remap
    ceOled130_writeCmd(ceOled130, 0xA6); //--normal / reverse
    ceOled130_writeCmd(ceOled130, 0xA8); //--set multiplex ratio(1 to 64)
    ceOled130_writeCmd(ceOled130, 0x3F); //--1/64 duty
    ceOled130_writeCmd(ceOled130, 0xAD); //set charge pump enable
    ceOled130_writeCmd(ceOled130, 0x8B); //-0x8B 内供 VCC
    ceOled130_writeCmd(ceOled130, 0x33); //-0X30---0X33 set VPP 9V
    ceOled130_writeCmd(ceOled130, 0xC8); //Com scan direction
    ceOled130_writeCmd(ceOled130, 0xD3); //-set display offset
    ceOled130_writeCmd(ceOled130, 0x00); //
    ceOled130_writeCmd(ceOled130, 0xD5); //set osc division
    ceOled130_writeCmd(ceOled130, 0x80); //
    ceOled130_writeCmd(ceOled130, 0xD8); //set area color mode off
    ceOled130_writeCmd(ceOled130, 0x05); //
    ceOled130_writeCmd(ceOled130, 0xD9); //Set Pre-Charge Period
    ceOled130_writeCmd(ceOled130, 0x1F); //
    ceOled130_writeCmd(ceOled130, 0xDA); //set com pin configuartion
    ceOled130_writeCmd(ceOled130, 0x12); //
    ceOled130_writeCmd(ceOled130, 0xDB); //set Vcomh
    ceOled130_writeCmd(ceOled130, 0x40); //
    ceOled130_writeCmd(ceOled130, 0xAF); //--turn on oled panel
    return CE_STATUS_SUCCESS;
}

/**
  * @brief  CeOled130打开显示
  * @param  ceOled130:CeOled130属性对象
  * @return None
  */
void ceOled130_setOn(CeOled130* ceOled130)
{
    ceOled130_writeCmd(ceOled130, 0X8D);  //设置电荷泵
    ceOled130_writeCmd(ceOled130, 0X14);  //开启电荷泵
    ceOled130_writeCmd(ceOled130, 0XAF);  //OLED唤醒
}

/**
  * @brief  CeOled130设置开始坐标
  * @param  ceOled130:CeOled130属性对象
  * @param  x:设置开始坐标的列坐标
  * @param  y:设置开始坐标的行坐标
  * @return None
  */
void ceOled130_setStartPos(CeOled130* ceOled130, uint8 x, uint8 y)
{
    x += 2;
    ceOled130_writeCmd(ceOled130, 0xb0 + y);
    ceOled130_writeCmd(ceOled130, ((x & 0xf0) >> 4) | 0x10);
    ceOled130_writeCmd(ceOled130, (x & 0x0f) | 0x01);
}

/**
  * @brief  CeOled130用指定数据(颜色)进行全屏填充
  * @param  ceOled130:CeOled130属性对象
  * @param  color:全屏填充的数据(颜色)
  * @return None
  */
void ceOled130_fill(CeOled130* ceOled130, uint8 fillData)
{
    uint8 m, n;
    for (m = 0; m < (CE_OLED130_HIGHT / 8); m++)
    {
        ceOled130_writeCmd(ceOled130, 0xb0 + m);//设置页地址,0-7(CE_OLED130_HIGHT / 8bit)
        ceOled130_writeCmd(ceOled130, 0x02);//low column start address
        ceOled130_writeCmd(ceOled130, 0x10);//high column start address
        for (n = 0; n < CE_OLED130_WIDTH; n++)
        {
            ceOled130_writeDat(ceOled130, fillData);
        }
    }
}

/**
  * @brief   CeOled130清屏
  * @param   ceOled130:CeOled130属性对象
  * @return  None
  */
void ceOled130_clr(CeOled130* ceOled130)
{
    ceOled130_fill(ceOled130, 0x00);
}

/**
  * @brief  CeOled130显示字符
  * @param  ceOled130:CeOled130属性对象
  * @param  x:设置开始显示字符的x轴坐标
  * @param  y:设置开始显示字符的y轴坐标
  * @param  msg:要显示的字符串指针
  * @param showSize:显示的字体大小，可选CE_TFT320_EN_SIZE_F6X8或CE_TFT320_EN_SIZE_F8X16
  * @return None
  */
void ceOled130_showChar(CeOled130* ceOled130, uint8 x, uint8 y, const char ch, CE_OLED130_EN_SIZE showSize)
{
    uint8 i, c;
    if (showSize == CE_OLED130_EN_SIZE_F6X8)
    {
        c =  ch - 32;
        ceOled130_setStartPos(ceOled130, x, y);
        for (i = 0; i < 6; i++)
        {
            ceOled130_writeDat(ceOled130, CE_OLED130_F6x8[c][i]);//6 * 8 = 48bit / 8bit = 6，所以每次写1个字节，一共写6次
        }
    }
    else
    {
        c = ch - 32;
        ceOled130_setStartPos(ceOled130, x, y);
        for (i = 0; i < 8; i++)
        {
            ceOled130_writeDat(ceOled130, CE_OLED130_F8X16[c * 16 + i]);//8 * 16 = 128bit / (8bit + 8bit) = 8，所以每次写2个字节，一共写8次
        }
        ceOled130_setStartPos(ceOled130, x, y + 1);
        for (i = 0; i < 8; i++)
        {
            ceOled130_writeDat(ceOled130, CE_OLED130_F8X16[c * 16 + i + 8]);
        }
    }
}

/**
  * @brief  CeOled130显示字符串，不支持中文
  * @param  ceOled130:CeOled130属性对象
  * @param  x:设置开始显示字符串的x轴坐标
  * @param  y:设置开始显示字符串的y轴坐标
  * @param  foreColor:显示字体的前景色
  * @param  backColor:显示字体的背景色
  * @param  msg:要显示的字符串指针
  * @param showSize:显示的字体大小，可选CE_TFT320_EN_SIZE_F6X8或CE_TFT320_EN_SIZE_F8X16
  * @return None
  */
void ceOled130_showString(CeOled130* ceOled130, uint8 x, uint8 y, char* msg, CE_OLED130_EN_SIZE showSize)
{
    uint8 i, count;
    count = ceStringOp.strlen(msg);
    for (i = 0; i < count; i++)
    {
        ceOled130_showChar(ceOled130, x + i * ((showSize == CE_OLED130_EN_SIZE_F6X8)?6:8), y, msg[i], showSize);
    }
}

/**
  * @brief  CeOled130显示32位有符号的数字，最大值0x7FFFFFFF，最小值0x80000001
  * @param  ceOled130:CeOled130属性对象
  * @param  x:设置开始显示32位有符号的数字的x轴坐标
  * @param  y:设置开始显示32位有符号的数字的y轴坐标
  * @param  foreColor:显示字体的前景色
  * @param  backColor:显示字体的背景色
  * @param val:要显示的32位有符号的数字
  * @param showSize:显示的字体大小，可选CE_TFT320_EN_SIZE_F6X8或CE_TFT320_EN_SIZE_F8X16
  * @return None
  */
void ceOled130_showInt(CeOled130* ceOled130, uint8 x, uint8 y, int32 val, CE_OLED130_EN_SIZE showSize)
{
    char temp[20];
    ceDebugOp.sprintf(temp, "%d", val);
    ceOled130_showString(ceOled130, x, y, temp, showSize);
}

/**
  * @brief  CeOled130显示16x16的中文字体，字模cn1616可从CeCN1616.h中获取
  * @param  ceOled130:CeOled130属性对象
  * @param  x:设置开始显示字符串的x轴坐标
  * @param  y:设置开始显示字符串的y轴坐标
  * @param  foreColor:显示字体的前景色
  * @param  backColor:显示字体的背景色
  * @param  cn1616:要显示的文字模，字模cn1616可从CeCN1616.h中获取
  * @return None
  */
void ceOled130_showCN1616(CeOled130* ceOled130, uint8 x, uint8 y, const uint8* cn1616)
{
    uint8 i, j, m;
    uint8 index = 0x80;
    uint8 wd;
    for (m = 0; m < 2; m++)
    {
        ceOled130_setStartPos(ceOled130, x, y + m);
        for (i = 0; i < 2; i++)
        {
            index = 0x80;
            for (j = 0; j < 8; j++)
            {
                wd = 0;
                wd |= ((cn1616[i + 0 + m * 16] & index) == index) ? 0x01 : 0x00;
                wd |= ((cn1616[i + 2 + m * 16] & index) == index) ? 0x02 : 0x00;
                wd |= ((cn1616[i + 4 + m * 16] & index) == index) ? 0x04 : 0x00;
                wd |= ((cn1616[i + 6 + m * 16] & index) == index) ? 0x08 : 0x00;
                wd |= ((cn1616[i + 8 + m * 16] & index) == index) ? 0x10 : 0x00;
                wd |= ((cn1616[i + 10 + m * 16] & index) == index) ? 0x20 : 0x00;
                wd |= ((cn1616[i + 12 + m * 16] & index) == index) ? 0x40 : 0x00;
                wd |= ((cn1616[i + 14 + m * 16] & index) == index) ? 0x80 : 0x00;
                index >>= 1;
                ceOled130_writeDat(ceOled130, wd);
            }
        }
    }
}

/**
  * @brief  CeOled130绘制图片
  * @param  ceOled130:CeOled130属性对象
  * @param  x:图片的起始点x坐标
  * @param  y:图片的起始点y坐标
  * @param  colorBuf:图片数据
  * @param  bufSizeWidth:图片宽
  * @param  bufSizeHight:图片高
  * @ return None
  */
void ceOled130_drawData(CeOled130* ceOled130, uint8 x, uint8 y, uint8 dataWidth, uint8 dataHight, const uint8* dataBuf)
{
    uint8 i,j;
    for (i = 0; i < dataHight; i++)
    {
        ceOled130_setStartPos(ceOled130,x, y+i);
        for (j = 0; j < dataWidth; j++)
        {
            ceOled130_writeDat(ceOled130,dataBuf[i*dataWidth+j]);
        }
    }
}

/**
  * @brief  一般用于代码调试，以控制台的方式打印调试信息
  * @param  ceOled130:CeOled130属性对象
  * @param  msg:要显示的信息
  * @return None
  */
void ceOled130_appendString(CeOled130* ceOled130, const char* msg)
{
    uint16 msgCoung = ceStringOp.strlen(msg);
    uint8 temp;
    uint16 i, j;
    for (i = 0; i < msgCoung + 1; i++)
    {
        if (msg[i] == '\r' || msg[i] == '\n')
        {
            for (j = ceOled130->asXIndex; j < CE_OLED130_WIDTH / 6; j++)
            {
                ceOled130->asBuf[j][ceOled130->asYIndex] = ' ';
            }
            ceOled130->asXIndex = 0;
            ceOled130->asYIndex++;
            if (ceOled130->asYIndex >= CE_OLED130_HIGHT / 8)
            {
                uint16 m, n;
                for (m = 0; m < CE_OLED130_HIGHT / 8 - 1; m++)
                {
                    for (n = 0; n < CE_OLED130_WIDTH / 6; n++)
                    {
                        ceOled130->asBuf[n][m] = ceOled130->asBuf[n][m + 1];
                    }
                }
                for (n = 0; n < CE_OLED130_WIDTH / 6; n++)
                {
                    ceOled130->asBuf[n][CE_OLED130_HIGHT / 8 - 1] = ' ';
                }
                ceOled130->asYIndex--;
            }
        }
        else if (msg[i] == '\0')
        {
            break;
        }
        else
        {
            ceOled130->asBuf[ceOled130->asXIndex][ceOled130->asYIndex] = msg[i];
            ceOled130->asXIndex++;
            if (ceOled130->asXIndex >= CE_OLED130_WIDTH / 6)
            {
                ceOled130->asXIndex = 0;
                ceOled130->asYIndex++;
                if (ceOled130->asYIndex >= CE_OLED130_HIGHT / 8)
                {
                    uint16 m, n;
                    for (m = 0; m < CE_OLED130_HIGHT / 8 - 1; m++)
                    {
                        for (n = 0; n < CE_OLED130_WIDTH / 6; n++)
                        {
                            ceOled130->asBuf[n][m] = ceOled130->asBuf[n][m + 1];
                        }
                    }
                    for (n = 0; n < CE_OLED130_WIDTH / 6; n++)
                    {
                        ceOled130->asBuf[n][CE_OLED130_HIGHT / 8 - 1] = ' ';
                    }
                    ceOled130->asYIndex--;
                }
            }
        }
    }
    for (i = 0; i < CE_OLED130_HIGHT / 8; i++)
    {
        for (j = 0; j < CE_OLED130_WIDTH / 6; j++)
        {
            temp = ceOled130->asBuf[j][i];
            ceOled130_showChar(ceOled130,  j * 6, i,temp, CE_OLED130_EN_SIZE_F6X8);
        }
    }
}

/**
  * @brief   关闭显示
  * @param   ceOled130:CeOled130属性对象
  * @return None
  */
void ceOled130_setOff(CeOled130* ceOled130)
{
    ceOled130_writeCmd(ceOled130, 0X8D);  //设置电荷泵
    ceOled130_writeCmd(ceOled130, 0X10);  //关闭电荷泵
    ceOled130_writeCmd(ceOled130, 0XAE);  //OLED休眠
}

const CeOled130Op ceOled130Op = {ceOled130_initial, ceOled130_setOn, ceOled130_fill, ceOled130_clr, ceOled130_showString, ceOled130_showInt, ceOled130_showCN1616,
                                        ceOled130_drawData, ceOled130_appendString,ceOled130_setOff};

#ifdef __cplusplus
 }
#endif //__cplusplus
