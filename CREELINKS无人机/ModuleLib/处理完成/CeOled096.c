/**
  ******************************************************************************
  * @file    CeOled096.c
  * @author  Creelinks Application Team
  * @version V1.0.0
  * @date    2017-01-06
  * @brief   适用于CeOled096模块的驱动库文件
  ******************************************************************************
  * @attention
  *
  *1)
  *
  * <h2><center>&copy; COPYRIGHT 2016 Darcern</center></h2>
  ******************************************************************************
  */
#include "CeOled096.h"
#ifdef __cplusplus
 extern "C" {
#endif //__cplusplus
#define CE_OLED096_ADDRESS      0x78 //通过调整0R电阻,屏可以0x78和0x7A两个地址 -- 默认0x78
#define CE_OLED096_WIDTH        128
#define CE_OLED096_HEIGHT       64
/**
  * @brief  CeOled096使用的6*8的点阵
  */
const unsigned char CE_OLED096_F6x8[][6] =
{
    0x00, 0x00, 0x00, 0x00, 0x00, 0x00, // sp
    0x00, 0x00, 0x00, 0x2f, 0x00, 0x00, // !
    0x00, 0x00, 0x07, 0x00, 0x07, 0x00, // "
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    0x14, 0x14, 0x14, 0x14, 0x14, 0x14, // horiz lines
};
/**
  * @brief  CeOled096使用的8*16的点阵
  */
const unsigned char CE_OLED096_F8X16[] =
{
    0x00, 0x00, 0x00, 0x00, 0x00, 0x00, 0x00, 0x00, 0x00, 0x00, 0x00, 0x00, 0x00, 0x00, 0x00, 0x00, // 0
    0x00, 0x00, 0x00, 0xF8, 0x00, 0x00, 0x00, 0x00, 0x00, 0x00, 0x00, 0x33, 0x30, 0x00, 0x00, 0x00, //! 1
    0x00, 0x10, 0x0C, 0x06, 0x10, 0x0C, 0x06, 0x00, 0x00, 0x00, 0x00, 0x00, 0x00, 0x00, 0x00, 0x00, //" 2
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    0x00, 0x06, 0x01, 0x01, 0x02, 0x02, 0x04, 0x04, 0x00, 0x00, 0x00, 0x00, 0x00, 0x00, 0x00, 0x00, //~ 94
};

/**
  * @brief  CeOled096往指定地址写1个字节的数据
  * @param  ceOled096:CeOled096属性对象
  * @param  addr:要写入数据的地址
  * @param  data:要写入的数据
  * @return None
  */
void ceOled096_writeByte(CeOled096* ceOled096, uint8_t addr, uint8_t data)
{
    ceI2cMasterOp.start(&ceOled096->ceI2cMaster);
    ceI2cMasterOp.writeByte(&ceOled096->ceI2cMaster, CE_OLED096_ADDRESS);
    ceI2cMasterOp.waitAck(&ceOled096->ceI2cMaster);
    ceI2cMasterOp.writeByte(&ceOled096->ceI2cMaster, addr);
    ceI2cMasterOp.waitAck(&ceOled096->ceI2cMaster);
    ceI2cMasterOp.writeByte(&ceOled096->ceI2cMaster, data);
    ceI2cMasterOp.waitAck(&ceOled096->ceI2cMaster);
    ceI2cMasterOp.stop(&ceOled096->ceI2cMaster);
}

/**
  * @brief  CeOled096写命令
  * @param  ceOled096:CeOled096属性对象
  * @param  I2C_Command:要写入的命令
  * @return None
  */
void ceOled096_writeCmd(CeOled096* ceOled096, uint8 I2C_Command)
{
    ceOled096_writeByte(ceOled096, 0x00, I2C_Command);
}

/**
  * @brief  CeOled096写数据
  * @param  ceOled096:CeOled096属性对象
  * @param  I2C_Data:要写入的数据
  * @return None
  */
void ceOled096_writeDat(CeOled096* ceOled096, uint8 I2C_Data)
{
    ceOled096_writeByte(ceOled096, 0x40, I2C_Data);
}

/**
  * @brief  CeOled096模块初始化
  * @param  ceOled096:CeOled096属性对象
  * @param  ceI2c:CeOled096模块使用的资源号
  * @return 系统状态码，可能的值:CE_STATUS_SUCCESS
  */
CE_STATUS ceOled096_initial(CeOled096* ceOled096, CE_RESOURCE ceI2c)
{
    uint16 i, j;
    for (j = 0; j < CE_OLED096_WIDTH / 6; j++)
    {
        for (i = 0; i < CE_OLED096_HIGHT / 8; i++)
        {
            ceOled096->asBuf[j][i] = ' ';
        }
    }
    ceOled096->asXIndex = 0;
    ceOled096->asYIndex = 0;

    ceOled096->ceI2cMaster.ceResource = ceI2c;
    ceOled096->ceI2cMaster.ceI2cMasterSpeed = CE_I2C_SPEED_3_4MBPS;
    ceI2cMasterOp.initial(&ceOled096->ceI2cMaster);
    ceSystemOp.delayMs(100); //这里的延时很重要
    ceOled096_writeCmd(ceOled096, 0xAE); //display off
    ceOled096_writeCmd(ceOled096, 0x20); //Set Memory Addressing Mode
    ceOled096_writeCmd(ceOled096, 0x10); //00,Horizontal Addressing Mode;01,Vertical Addressing Mode;10,Page Addressing Mode (RESET);11,Invalid
    ceOled096_writeCmd(ceOled096, 0xb0); //Set Page Start Address for Page Addressing Mode,0-7
    ceOled096_writeCmd(ceOled096, 0xc8); //Set COM Output Scan Direction
    ceOled096_writeCmd(ceOled096, 0x00); //---set low column address
    ceOled096_writeCmd(ceOled096, 0x10); //---set high column address
    ceOled096_writeCmd(ceOled096, 0x40); //--set start line address
    ceOled096_writeCmd(ceOled096, 0x81); //--set contrast control register
    ceOled096_writeCmd(ceOled096, 0xff); //亮度调节 0x00~0xff
    ceOled096_writeCmd(ceOled096, 0xa1); //--set segment re-map 0 to 127
    ceOled096_writeCmd(ceOled096, 0xa6); //--set normal display
    ceOled096_writeCmd(ceOled096, 0xa8); //--set multiplex ratio(1 to 64)
    ceOled096_writeCmd(ceOled096, 0x3F); //
    ceOled096_writeCmd(ceOled096, 0xa4); //0xa4,Output follows RAM content;0xa5,Output ignores RAM content
    ceOled096_writeCmd(ceOled096, 0xd3); //-set display offset
    ceOled096_writeCmd(ceOled096, 0x00); //-not offset
    ceOled096_writeCmd(ceOled096, 0xd5); //--set display clock divide ratio/oscillator frequency
    ceOled096_writeCmd(ceOled096, 0xf0); //--set divide ratio
    ceOled096_writeCmd(ceOled096, 0xd9); //--set pre-charge period
    ceOled096_writeCmd(ceOled096, 0x22); //
    ceOled096_writeCmd(ceOled096, 0xda); //--set com pins hardware configuration
    ceOled096_writeCmd(ceOled096, 0x12);
    ceOled096_writeCmd(ceOled096, 0xdb); //--set vcomh
    ceOled096_writeCmd(ceOled096, 0x20); //0x20,0.77xVcc
    ceOled096_writeCmd(ceOled096, 0x8d); //--set DC-DC enable
    ceOled096_writeCmd(ceOled096, 0x14); //
    ceOled096_writeCmd(ceOled096, 0xaf); //--turn on oled panel
    return CE_STATUS_SUCCESS;
}

/**
  * @brief  CeOled096打开显示
  * @param  ceOled096:CeOled096属性对象
  * @return None
  */
void ceOled096_setOn(CeOled096* ceOled096)
{
    ceOled096_writeCmd(ceOled096, 0X8D);  //设置电荷泵
    ceOled096_writeCmd(ceOled096, 0X14);  //开启电荷泵
    ceOled096_writeCmd(ceOled096, 0XAF);  //OLED唤醒
}

/**
  * @brief  CeOled096设置开始坐标
  * @param  ceOled096:CeOled096属性对象
  * @param  startX:设置开始坐标的列坐标
  * @param  startY:设置开始坐标的行坐标
  * @return None
  */
void ceOled096_setStartPos(CeOled096* ceOled096, uint8 x, uint8 y)
{
    ceOled096_writeCmd(ceOled096, 0xb0 + y);
    ceOled096_writeCmd(ceOled096, ((x & 0xf0) >> 4) | 0x10);
    ceOled096_writeCmd(ceOled096, (x & 0x0f) | 0x01);
}

/**
  * @brief  CeOled096用指定数据进行全屏填充
  * @param  ceOled096:CeOled096属性对象
  * @param  fillData:全屏填充的数据
  * @return None
  */
void ceOled096_fill(CeOled096* ceOled096, uint8 fillData)  //全屏填充
{
    uint8 m, n;
    for (m = 0; m < (CE_OLED096_HIGHT / 8); m++)
    {
        ceOled096_writeCmd(ceOled096, 0xb0 + m);//设置页地址,0-7(CE_OLED096_HIGHT / 8bit)
        ceOled096_writeCmd(ceOled096, 0x00);//low column start address
        ceOled096_writeCmd(ceOled096, 0x10);//high column start address
        for (n = 0; n < CE_OLED096_WIDTH; n++)
        {
            ceOled096_writeDat(ceOled096, fillData);
        }
    }
}

/**
  * @brief  CeOled096清屏，建议在开始操作前调用一次，清屏后整个屏幕全黑
  * @param  ceOled096:CeOled096属性对象
  * @return None
  */
void ceOled096_clr(CeOled096* ceOled096)
{
    ceOled096_fill(ceOled096, 0x00);
}

/**
  * @brief  CeOled096显示字符
  * @param  ceOled096:CeOled096属性对象
  * @param  x:设置开始显示字符的x轴坐标
  * @param  y:设置开始显示字符的y轴坐标
  * @param  msg:要显示的字符串指针
  * @param showSize:显示的字体大小，可选CE_TFT320_EN_SIZE_F6X8或CE_TFT320_EN_SIZE_F8X16
  * @return None
  */
void ceOled096_showChar(CeOled096* ceOled096, uint8 x, uint8 y, const char ch, CE_OLED096_EN_SIZE showSize)
{
    uint8 i, c;
    if (showSize == CE_OLED096_EN_SIZE_F6X8)
    {
        c =  ch - 32;
        ceOled096_setStartPos(ceOled096, x, y);
        for (i = 0; i < 6; i++)
        {
            ceOled096_writeDat(ceOled096, CE_OLED096_F6x8[c][i]);//6 * 8 = 48bit / 8bit = 6，所以每次写1个字节，一共写6次
        }
    }
    else
    {
        c = ch - 32;
        ceOled096_setStartPos(ceOled096, x, y);
        for (i = 0; i < 8; i++)
        {
            ceOled096_writeDat(ceOled096, CE_OLED096_F8X16[c * 16 + i]);//8 * 16 = 128bit / (8bit + 8bit) = 8，所以每次写2个字节，一共写8次
        }
        ceOled096_setStartPos(ceOled096, x, y + 1);
        for (i = 0; i < 8; i++)
        {
            ceOled096_writeDat(ceOled096, CE_OLED096_F8X16[c * 16 + i + 8]);
        }
    }
}

/**
  * @brief  CeOled096显示字符串
  * @param  ceOled096:CeOled096属性对象
  * @param  x:设置开始显示字符串的x轴坐标。
  * @param  y:设置开始显示字符串的y轴坐标(也就是行坐标，CeOled096可以显示8行F6x8，和4行F8x16的字体)
  * @param  msg:要显示的字符串指针
  * @param  showSize:显示的字体大小，可选CE_OLED_SIZE_F6X8或CE_OLED_SIZE_F8X16
  */
void ceOled096_showString(CeOled096* ceOled096, uint8 x, uint8 y, char* msg, CE_OLED096_EN_SIZE showSize)
{
    uint8 i, count;
    count = ceStringOp.strlen(msg);
    for (i = 0; i < count; i++)
    {
        ceOled096_showChar(ceOled096, x + i * ((showSize == CE_OLED096_EN_SIZE_F6X8)?6:8), y, msg[i], showSize);
    }
}

/**
  * @param  ceOled096:CeOled096属性对象
  * @param  x:设置开始显示32位有符号的数字的x轴坐标
  * @param  y:设置开始显示32位有符号的数字的y轴坐标(也就是行坐标，CeOled096可以显示8行F6x8，和4行F8x16的字体)
  * @param  val:要显示的32位有符号的数字
  * @param  showSize:显示的字体大小，可选CE_OLED_SIZE_F6X8或CE_OLED_SIZE_F8X16
  */
void ceOled096_showInt(CeOled096* ceOled096, uint8 x, uint8 y, int32 val, CE_OLED096_EN_SIZE showSize)
{
    char temp[20];
    ceDebugOp.sprintf(temp, "%d", val);
    ceOled096_showString(ceOled096, x, y, temp, showSize);
}

/**
  * @brief CeOled096显示16x16的汉字
  * @param ceOled096:CeOled096属性对象
  * @param x:设置开始显示32位有符号的数字的x轴坐标
  * @param y:设置开始显示32位有符号的数字的y轴坐标(也就是行坐标，CeOled096可以显示4行16x16的汉字)
  * @param cn1616:要显示的汉字字模，可从"CeCN1616.h"中获取
  */
void ceOled096_showCN1616(CeOled096* ceOled096, uint8 x, uint8 y, const uint8* cn1616)
{
    int i, j, m;
    uint8 index = 0x80;
    uint8 wd;
    for (m = 0; m < 2; m++)
    {
        ceOled096_setStartPos(ceOled096, x, y + m);
        for (i = 0; i < 2; i++)
        {
            index = 0x80;
            for (j = 0; j < 8; j++)
            {
                wd = 0;
                wd |= ((cn1616[i + 0 + m * 16] & index) == index) ? 0x01 : 0x00;
                wd |= ((cn1616[i + 2 + m * 16] & index) == index) ? 0x02 : 0x00;
                wd |= ((cn1616[i + 4 + m * 16] & index) == index) ? 0x04 : 0x00;
                wd |= ((cn1616[i + 6 + m * 16] & index) == index) ? 0x08 : 0x00;
                wd |= ((cn1616[i + 8 + m * 16] & index) == index) ? 0x10 : 0x00;
                wd |= ((cn1616[i + 10 + m * 16] & index) == index) ? 0x20 : 0x00;
                wd |= ((cn1616[i + 12 + m * 16] & index) == index) ? 0x40 : 0x00;
                wd |= ((cn1616[i + 14 + m * 16] & index) == index) ? 0x80 : 0x00;
                index >>= 1;
                ceOled096_writeDat(ceOled096, wd);
            }

        }
    }
}
/**
  * @brief CeOled096显示16x16的汉字
  * @param ceOled096:CeOled096属性对象
  * @param x:设置开始显示32位有符号的数字的x轴坐标
  * @param y:设置开始显示32位有符号的数字的y轴坐标(也就是行坐标，CeOled096可以显示4行16x16的汉字)
  * @param cn1616:要显示的汉字字模，可从"CeCN1616.h"中获取
  */
void ceOled096_drawData(CeOled096* ceOled096, uint8 x, uint8 y, uint8 dataWidth, uint8 dataHight, const uint8* dataBuf)
{
    unsigned int i, j;
    for (i = 0; i < dataHight; i++)
    {
        ceOled096_setStartPos(ceOled096, x, y+i);
        for (j = 0; j < dataWidth; j++)
        {
            ceOled096_writeDat(ceOled096, dataBuf[i*dataWidth + j]);
        }
    }
}

/**
  * @brief  一般用于代码调试，以控制台的方式打印调试信息
  * @param   ceOled096:CeOled096属性对象
  * @param  msg:要显示的信息
  */
void ceOled096_appendString(CeOled096* ceOled096, const char* msg)
{
    uint16 msgCoung = ceStringOp.strlen(msg);
    uint16 i, j;
    char temp;
    for (i = 0; i < msgCoung + 1; i++)
    {
        if (msg[i] == '\r' || msg[i] == '\n')
        {
            for (j = ceOled096->asXIndex; j < CE_OLED096_WIDTH / 6; j++)
            {
                ceOled096->asBuf[j][ceOled096->asYIndex] = ' ';
            }
            ceOled096->asXIndex = 0;
            ceOled096->asYIndex++;
            if (ceOled096->asYIndex >= CE_OLED096_HIGHT / 8)
            {
                uint16 m, n;
                for (m = 0; m < CE_OLED096_HIGHT / 8 - 1; m++)
                {
                    for (n = 0; n < CE_OLED096_WIDTH / 6; n++)
                    {
                        ceOled096->asBuf[n][m] = ceOled096->asBuf[n][m + 1];
                    }
                }
                for (n = 0; n < CE_OLED096_WIDTH / 6; n++)
                {
                    ceOled096->asBuf[n][CE_OLED096_HIGHT / 8 - 1] = ' ';
                }
                ceOled096->asYIndex--;
            }
        }
        else if (msg[i] == '\0')
        {
            break;
        }
        else
        {
            ceOled096->asBuf[ceOled096->asXIndex][ceOled096->asYIndex] = msg[i];
            ceOled096->asXIndex++;
            if (ceOled096->asXIndex >= CE_OLED096_WIDTH / 6)
            {
                ceOled096->asXIndex = 0;
                ceOled096->asYIndex++;
                if (ceOled096->asYIndex >= CE_OLED096_HIGHT / 8)
                {
                    uint16 m, n;
                    for (m = 0; m < CE_OLED096_HIGHT / 8 - 1; m++)
                    {
                        for (n = 0; n < CE_OLED096_WIDTH / 6; n++)
                        {
                            ceOled096->asBuf[n][m] = ceOled096->asBuf[n][m + 1];
                        }
                    }
                    for (n = 0; n < CE_OLED096_WIDTH / 6; n++)
                    {
                        ceOled096->asBuf[n][CE_OLED096_HIGHT / 8 - 1] = ' ';
                    }
                    ceOled096->asYIndex--;
                }
            }
        }
    }
    for (i = 0; i < CE_OLED096_HIGHT / 8; i++)
    {
        for (j = 0; j < CE_OLED096_WIDTH / 6; j++)
        {
            temp = ceOled096->asBuf[j][i];
            ceOled096_showChar(ceOled096, j * 6, i, temp, CE_OLED096_EN_SIZE_F6X8);
        }
    }
}
/**
  * @brief CeOled096关闭显示
  * @param ceOled096:CeOled096属性对象
  * @return None
  */
void ceOled096_setOff(CeOled096* ceOled096)
{
    ceOled096_writeCmd(ceOled096, 0X8D);  //设置电荷泵
    ceOled096_writeCmd(ceOled096, 0X10);  //关闭电荷泵
    ceOled096_writeCmd(ceOled096, 0XAE);  //OLED休眠
}

const CeOled096Op ceOled096Op = {ceOled096_initial, ceOled096_setOn, ceOled096_fill, ceOled096_clr, ceOled096_showString, ceOled096_showInt, ceOled096_showCN1616,
                                        ceOled096_drawData,ceOled096_appendString, ceOled096_setOff };

#ifdef __cplusplus
 }
#endif //__cplusplus
